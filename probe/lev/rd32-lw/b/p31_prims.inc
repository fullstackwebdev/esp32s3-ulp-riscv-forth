/* P31: generated by p31_gen.py from uforth.c's PRIMS macro. One entry per line so each
 * primitive can be dropped by ID; order is the original, so the enum's token values and
 * therefore variant A's code are unchanged. */
#if !defined(P31_SUBSET) || defined(P_HAVE_EXIT)
X(EXIT,"EXIT",0)
#endif
#if !defined(P31_SUBSET) || defined(P_HAVE_LIT)
X(LIT,"LIT",0)
#endif
#if !defined(P31_SUBSET) || defined(P_HAVE_BRANCH)
X(BRANCH,"BRANCH",0)
#endif
#if !defined(P31_SUBSET) || defined(P_HAVE_ZBRANCH)
X(ZBRANCH,"0BRANCH",0)
#endif
#if !defined(P31_SUBSET) || defined(P_HAVE_DO)
X(DO,"(DO)",0)
#endif
#if !defined(P31_SUBSET) || defined(P_HAVE_LOOP)
X(LOOP,"(LOOP)",0)
#endif
#if !defined(P31_SUBSET) || defined(P_HAVE_PLOOP)
X(PLOOP,"(+LOOP)",0)
#endif
#if !defined(P31_SUBSET) || defined(P_HAVE_I)
X(I,"I",0)
#endif
#if !defined(P31_SUBSET) || defined(P_HAVE_J)
X(J,"J",0)
#endif
#if !defined(P31_SUBSET) || defined(P_HAVE_UNLOOP)
X(UNLOOP,"UNLOOP",0)
#endif
#if !defined(P31_SUBSET) || defined(P_HAVE_EXEC)
X(EXEC,"EXECUTE",0)
#endif
#if !defined(P31_SUBSET) || defined(P_HAVE_DUP)
X(DUP,"DUP",0)
#endif
#if !defined(P31_SUBSET) || defined(P_HAVE_DROP)
X(DROP,"DROP",0)
#endif
#if !defined(P31_SUBSET) || defined(P_HAVE_SWAP)
X(SWAP,"SWAP",0)
#endif
#if !defined(P31_SUBSET) || defined(P_HAVE_OVER)
X(OVER,"OVER",0)
#endif
#if !defined(P31_SUBSET) || defined(P_HAVE_ROT)
X(ROT,"ROT",0)
#endif
#if !defined(P31_SUBSET) || defined(P_HAVE_TOR)
X(TOR,">R",0)
#endif
#if !defined(P31_SUBSET) || defined(P_HAVE_RFROM)
X(RFROM,"R>",0)
#endif
#if !defined(P31_SUBSET) || defined(P_HAVE_FETCH)
X(FETCH,"@",0)
#endif
#if !defined(P31_SUBSET) || defined(P_HAVE_STORE)
X(STORE,"!",0)
#endif
#if !defined(P31_SUBSET) || defined(P_HAVE_CFETCH)
X(CFETCH,"C@",0)
#endif
#if !defined(P31_SUBSET) || defined(P_HAVE_CSTORE)
X(CSTORE,"C!",0)
#endif
#if !defined(P31_SUBSET) || defined(P_HAVE_WFETCH)
X(WFETCH,"W@",0)
#endif
#if !defined(P31_SUBSET) || defined(P_HAVE_WSTORE)
X(WSTORE,"W!",0)
#endif
#if !defined(P31_SUBSET) || defined(P_HAVE_ADD)
X(ADD,"+",0)
#endif
#if !defined(P31_SUBSET) || defined(P_HAVE_SUB)
X(SUB,"-",0)
#endif
#if !defined(P31_SUBSET) || defined(P_HAVE_MUL)
X(MUL,"*",0)
#endif
#if !defined(P31_SUBSET) || defined(P_HAVE_DIVMOD)
X(DIVMOD,"/MOD",0)
#endif
#if !defined(P31_SUBSET) || defined(P_HAVE_UDIVMOD)
X(UDIVMOD,"U/MOD",0)
#endif
#if !defined(P31_SUBSET) || defined(P_HAVE_AND)
X(AND,"AND",0)
#endif
#if !defined(P31_SUBSET) || defined(P_HAVE_OR)
X(OR,"OR",0)
#endif
#if !defined(P31_SUBSET) || defined(P_HAVE_XOR)
X(XOR,"XOR",0)
#endif
#if !defined(P31_SUBSET) || defined(P_HAVE_INVERT)
X(INVERT,"INVERT",0)
#endif
#if !defined(P31_SUBSET) || defined(P_HAVE_LSHIFT)
X(LSHIFT,"LSHIFT",0)
#endif
#if !defined(P31_SUBSET) || defined(P_HAVE_RSHIFT)
X(RSHIFT,"RSHIFT",0)
#endif
#if !defined(P31_SUBSET) || defined(P_HAVE_ZEQ)
X(ZEQ,"0=",0)
#endif
#if !defined(P31_SUBSET) || defined(P_HAVE_LT)
X(LT,"<",0)
#endif
#if !defined(P31_SUBSET) || defined(P_HAVE_ULT)
X(ULT,"U<",0)
#endif
#if !defined(P31_SUBSET) || defined(P_HAVE_KEY)
X(KEY,"KEY",0)
#endif
#if !defined(P31_SUBSET) || defined(P_HAVE_KEYQ)
X(KEYQ,"KEY?",0)
#endif
#if !defined(P31_SUBSET) || defined(P_HAVE_EMIT)
X(EMIT,"EMIT",0)
#endif
#if !defined(P31_SUBSET) || defined(P_HAVE_TYPE)
X(TYPE,"TYPE",0)
#endif
#if !defined(P31_SUBSET) || defined(P_HAVE_COMMA)
X(COMMA,",",0)
#endif
#if !defined(P31_SUBSET) || defined(P_HAVE_WCOMMA)
X(WCOMMA,"W,",0)
#endif
#if !defined(P31_SUBSET) || defined(P_HAVE_CCOMMA)
X(CCOMMA,"C,",0)
#endif
#if !defined(P31_SUBSET) || defined(P_HAVE_COLON)
X(COLON,":",0)
#endif
#if !defined(P31_SUBSET) || defined(P_HAVE_SEMI)
X(SEMI,";",1)
#endif
#if !defined(P31_SUBSET) || defined(P_HAVE_CREATE)
X(CREATE,"CREATE",0)
#endif
#if !defined(P31_SUBSET) || defined(P_HAVE_CONSTANT)
X(CONSTANT,"CONSTANT",0)
#endif
#if !defined(P31_SUBSET) || defined(P_HAVE_TICK)
X(TICK,"'",0)
#endif
#if !defined(P31_SUBSET) || defined(P_HAVE_BTICK)
X(BTICK,"[']",1)
#endif
#if !defined(P31_SUBSET) || defined(P_HAVE_LITERAL)
X(LITERAL,"LITERAL",1)
#endif
#if !defined(P31_SUBSET) || defined(P_HAVE_DOTQ)
X(DOTQ,".\"",1)
#endif
#if !defined(P31_SUBSET) || defined(P_HAVE_PDOTQ)
X(PDOTQ,"(.\")",0)
#endif
#if !defined(P31_SUBSET) || defined(P_HAVE_BSLASH)
X(BSLASH,"\\",1)
#endif
#if !defined(P31_SUBSET) || defined(P_HAVE_PAREN)
X(PAREN,"(",1)
#endif
#if !defined(P31_SUBSET) || defined(P_HAVE_GPIOG)
X(GPIOG,"GPIO@",0)
#endif
#if !defined(P31_SUBSET) || defined(P_HAVE_GPIOS)
X(GPIOS,"GPIO!",0)
#endif
#if !defined(P31_SUBSET) || defined(P_HAVE_ADCG)
X(ADCG,"ADC@",0)
#endif
#if !defined(P31_SUBSET) || defined(P_HAVE_MS)
X(MS,"MS",0)
#endif
#if !defined(P31_SUBSET) || defined(P_HAVE_WAKE)
X(WAKE,"WAKE",0)
#endif
#if !defined(P31_SUBSET) || defined(P_HAVE_PAUSE)
X(PAUSE,"PAUSE",0)
#endif
#if !defined(P31_SUBSET) || defined(P_HAVE_FAULT)
X(FAULT,"FAULT",0)
#endif
