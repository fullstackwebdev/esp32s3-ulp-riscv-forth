
/* ULP variable definitions for the linker.
 * This file is generated automatically by esp32ulp_mapgen.py utility.
 */
PROVIDE ( ulp_main = 0x500003da );
PROVIDE ( ulp_pl_emit = 0x500002de );
PROVIDE ( ulp_reset_vector = 0x50000000 );
PROVIDE ( ulp_RTCCNTL = 0x50008000 );
PROVIDE ( ulp_SENS = 0x5000c800 );
PROVIDE ( ulp___stack_top = 0x50001ff0 );
PROVIDE ( ulp___start = 0x50000004 );
PROVIDE ( ulp_ulp_riscv_halt = 0x50000e44 );
PROVIDE ( ulp_ulp_riscv_rescue_from_monitor = 0x50000e30 );
