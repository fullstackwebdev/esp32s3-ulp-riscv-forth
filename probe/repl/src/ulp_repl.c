/* ulp_repl.c — the ULP side of the console: a byte pump between two rings and the interpreter.
 *
 * Wake cycle: pull characters out of repl_cmd[], echo them, and on a newline call interpret() and
 * print the prompt. Then retire. Nothing blocks; nothing waits; every wake does a bounded amount.
 *
 * The rings live in RTC memory, which is the only channel to the HP core. The HP writes cmd_head and
 * reads cmd_tail; the ULP is the other way round on each ring. One writer per index, u32-aligned, so
 * no lock is needed for the indices themselves (P27's lesson: the machine state is what needs care,
 * not the counters).
 *
 * GUARDRAIL: the engine's own variables (tib/tl/ti/errf/V_*) are statics inside uforth.c, so this
 * file must include it — and the dictionary must arrive via IMAGE (.data), never boot_init() on the
 * ULP. Calling both lays the primitive headers over the baked prelude and every word resolves wrong
 * while still printing something plausible (P39 measured exactly that).
 *
 * GUARDRAIL: pl_emit must never allocate or block. It writes into repl_out[] and drops bytes when the
 * ring is full, counting the drops in repl_out_drop. A silent drop here would hide a word's output
 * and make a working program look broken.
 */
/* GUARDRAIL: MEMSZ must be sized to the POOL, not to the baked image. image.h declares
 * `static u8 mem[MEMSZ]`, so every byte above V_HERE (1 136 B) costs exactly one pool byte, and
 * 1 872 puts the whole pool at 7 856 B with 736 B of app space. It sat at 1 280 for weeks, which left
 * 592 B of the pool idle while app space was 144 B; the docs compounded the error by quoting 620 B,
 * a figure that needed MEMSZ 2 196 and therefore an 8 180 B pool (E-054). Overflow past 1 872 is NOT
 * caught by the linker — check the size report, not the link. */
/* GUARDRAIL: pool = MEMSZ + 5798 with the 64/128 rings (data is MEMSZ+8, text 4830, bss 960), so the
 * ceiling is 2058 and not the 2064 the previous arithmetic implied — the ring edit itself moved text by
 * 6 B. 2 048 is the round number that keeps a 10 B margin: app space 912 B, pool 7 846 of 7 856.
 * Recompute this constant whenever .text or .bss changes; overflow is silent (E-054). */
/* GUARDRAIL: MEMSZ and src/image.h are ONE decision, not two. The image embeds V_LATEST as an absolute
 * address (base of the header area), so raising MEMSZ without re-baking points the dictionary outside
 * mem[]: the link succeeds, the boot assert is the only thing between that and "every word is unknown"
 * (E-079). Re-bake with tools/bake.sh <MEMSZ>, which owns the flag set, whenever this number moves.
 * 1 200 -> 1 400 is paid for exactly by the mailbox shrink in uforth.c (216 B -> 16 B of .bss). */
/* GUARDRAIL: 2296 -> 2040 on the overlay-manager branch, and the reason is measured, not tuned: the LOAD
 * primitive's text (the chunked copy + the outer-interpreter call) puts the pool at 8 111 / 7 856, i.e.
 * 255 B over, and MEMSZ is 1:1 with the pool because mem[] IS the image. So overlays cost ~105 B of
 * dictionary AND ~255 B of app space on this build - the capability is bought with the very space it
 * makes optional. flash_safe refused the oversized image (exit 1), which is why this number exists. */
/* GUARDRAIL: MEMSZ 1936 -> 2700 banks the task machinery's 806 B as application space, leaving ~53 B of pool free
 * (7 845 -> 7 039 + 764). Not all of it: a pool with no slack is one edit away from a link failure that looks like a
 * code bug. MEMSZ and src/image.h are ONE decision - the baked dictionary embeds absolute addresses derived from this
 * value, so image.h must be regenerated by tools/bake.sh after any change here, or the ULP runs a dictionary built for
 * a different memory size. */
/* GUARDRAIL: MEMSZ growth is NOT free slack - it eats the STACK REGION, because the stack top is fixed at 0x1FF0 and the
 * image grows up towards it. Measured: 2700 -> 2744 (+44 B) moved the image end past the canary base 0x1EAC, so the
 * stack paint started overwriting .bss; `#k` then reported 316 B of 324 used and the golden battery dropped to 15/17.
 * At 2700 the stack region is 332 B with a measured high-water of 240 B (92 B margin). Do not raise this without moving
 * the canary base and re-measuring, and never to within 40 B of the high-water: overflow is SILENT. Re-bake image.h
 * after any change here - MEMSZ and the baked dictionary are one decision. */
/* GUARDRAIL: 2700 -> 2651 pays for the KEY primitive. pl_key/pl_keyq (raw ring reads, so a Forth menu can own the
 * keyboard) measured +102 B of .text, which put the pool at 7941 and the stack region at 251 B - below the 300 B floor
 * that the measured 240 B high-water plus margin requires. 49 B of dictionary buys keys back: pool 7892, region exactly
 * 300 B. A keyboard is worth more than 49 bytes of app space; a 251 B stack region would be silent corruption. */
/* GUARDRAIL: 2620 -> 2604 pays for the KEY queue (a published cell plus the host's raw path). The stack region stays at
 * 317 B, above the 300 B floor set by the measured 240 B high-water; the dictionary gives up 16 B instead. A working
 * keyboard is worth more than 16 bytes of program. */
/* GUARDRAIL: 2604 -> 2560 buys the hardware gate in P() (F-149) out of APP SPACE instead of the stack margin.
 * MEMSZ is 1:1 pool bytes (the 256 B block window lives inside mem[]), so -44 here is +44 of pool; and app space measured
 * (LATEST 2152 - HERE 786) was 1 366 B, so the trade costs 3 % of a surplus to buy 44 % of the pool's free space. That is
 * the right direction: the pool is the scarce budget, the dictionary is not. Any future edit that needs pool bytes should
 * look here first, and re-measure both numbers rather than assuming the surplus is still there. */
/* GUARDRAIL: 1 704 left the image 131 B over the 7 856 B limit with the block layer linked; 1 500 lands at ~7 780.
 * App space is (MEMSZ - BLKSZ - headers) - V_HERE, which the countdown now computes from V_LATEST.
 * GUARDRAIL: this block was once orphaned - a probe edit replaced the `#define` line and left these two comment
 * fragments outside any comment, which the compiler reported as "expected identifier before numeric constant" plus a
 * cascade of nonsense from _stdint.h. When a probe changes MEMSZ, change the value, not the line the comment sits on. */
/* GUARDRAIL: 2565, and this byte-count is a two-sided constraint, measured:
 * the App Store compiles its resident INTO the running dictionary at run
 * time, so at 2540 the resident overflowed silently and `K` vanished - the
 * store then reported `block 17: STEP?`, a missing-word error three words
 * away from the real fault (F-150: a dictionary overflow names nothing). At
 * 2550 the sealed phase window was 983 B and calc1.fs is 995 B, so the store
 * refused to build and its 16 checks failed on an empty shelf. The window is
 * MEMSZ - 1567 B of resident, measured 983 at 2550 and 973 at 2540, and the
 * image may not exceed 7 932 B: 7 907 at 2540 plus 25 bytes = 2565 is the
 * largest pool that fits. 2 562 is where the two sides meet: image 7 932 B exactly (measured, and
 * 2 565 measured 7 935 - over), phase window 995 B, and calc1.fs is 995 B.
 * The LoRa driver no longer needs any of this: it used to carry the
 * coprocessor's own pad bring-up (200 B of dictionary), and that went away
 * once the main core was shown to configure the pads. MEMSZ and src/image.h
 * are ONE decision - bake.sh's argument must be the same number, and the
 * mismatch check names it if they drift. */
#define MEMSZ    2566

/* GUARDRAIL: SD stays 16. Raising it to 24 was rejected by the engine's own static assertions - dispatch.S hard-codes
 * the VM layout and assumes SD=16 for the stack wrap check - so deeper stacks would mean rewriting the asm dispatch.
 * An app that overflows therefore has to nest less, not ask for a bigger stack. */
#define SD        16            /* P13: peak 108 B */
/* GUARDRAIL: 96, not 128. The line buffer is 32 B of .bss for a 127-character limit that nothing uses:
 * the longest line any device workload types is 88 characters (bench/arith.fs), and the prelude's 98-character
 * lines are loaded by the HOST bake, which sets -DTIBSZ=128 independently (tools/bake.sh), so the bake is
 * unaffected. The device limit becomes 95 characters and an over-long line is REFUSED BY NAME
 * (MSG_LINE_TOO_LONG) — loud, not silent. GUARDRAIL: the host suite still builds at TIBSZ 128, so a test
 * line longer than 94 would pass there and fail on the chip: keep typed lines short. */
#define TIBSZ     96
/* P47: the VM switch was two libgcc `memcpy` calls (136 B struct copies) and a `memset`, 127
 * instructions = 7 % of text. uforth.c already carries hand-written word copies behind this flag;
 * measured here at -356 B (text 5 156 -> 4 800), which is the largest byte win available without
 * deleting a requirement. Spent on MEMSZ: app space 226 -> 578 B, R4 intact. */
/* GUARDRAIL: P33_BLOCK/BLKPRIM/BLKSZ/BLK_MB live HERE, in the same header the bake must use, because
 * BLKADR = MEMSZ - BLKSZ is baked into the image as an absolute and computed again in the ULP; a bake with
 * a different BLKSZ puts the buffer where the dictionary expects it to be and the first fetch overwrites
 * definitions (F-107's cousin). 256 B halves the window; at 144 us per fetch the extra fetches are cheap
 * per command, and 512 B does not fit the pool alongside R4.
 * GUARDRAIL: 1 200 / 128 is a MEASURED fitting point, not a preference: with the block primitive bodies
 * actually linked the image is 8 139 B at MEMSZ 1 500 (283 B over the 7 856 B pool), and overflow is
 * silent — the linker succeeds, the ULP stack runs into .bss, and the machine boots printing nothing.
 * 1 200 / 128 lands at 7 839 B and still leaves ~154 B of app space. The honest fix for app space is the
 * primitive subset (~344 B), not a bigger window.
 * GUARDRAIL: the mailbox is 4 words (blk, op, status, checksum) — blk, op and checksum are written before
 * the doorbell and status last, so the ULP never reads a half-copied buffer. */
/* GUARDRAIL: OFF in the P52 bench build only, and off means UNDEFINED — `#define P33_BLOCK 0` still satisfies
 * `#if defined(P33_BLOCK)` at uforth.c:174/473/889, so the first attempt at a lean bench image changed the
 * section sizes by exactly 0 B and cost a build cycle. Blocks cost ~300 B of primitive bodies plus 4 B per
 * header; the P52 workloads use none of them. Lowering MEMSZ instead would move the header area image.h was
 * baked against (F-79: an image baked at a different MEMSZ points outside mem[]). */
#define P33_BLOCK 1
#define BLKPRIM   1
/* GUARDRAIL: the overlay experiment's LOAD primitive is its own switch, not an edit, for P30's reason:
 * every earlier variant must keep compiling to its own byte-for-byte .text or the deltas stop meaning
 * anything. bake.sh must define the SAME switch or the baked dictionary and the chip disagree (F-79). */
#define OVL_LOAD  1
#define BLKSZ     128
#define BLK_MB    4
/* P52: DEVICE BENCH BUILD ONLY — OFF for shipping. P52_LINECYC adds a per-line rdcycle pair and a
 * number-printer, P42_COUNT adds a load/add/store to every dispatch. Measured cost of both: .text
 * 5 250 -> 5 496 and 65 B of pool headroom against the shipping image's 3 B. */
/* #define P52_LINECYC 1 */
/* #define P42_COUNT   1 */
#define P30_HANDCOPY 1
#define P33_NOPAGE 1            /* no frames, no page table */
/* P54 idea 1 (measured in probe/research/P54-ops): 10 same-shape primitive bodies (+ - * AND OR XOR
 * LSHIFT RSHIFT < U<) become one table-driven kernel. Measured there: .text 5 252 -> 4 972, .rodata
 * 308 -> 364, pool -224 B, and the baked dictionary is BYTE-IDENTICAL because no word changes.
 * GUARDRAIL: the rung number is load-bearing. `-DP54_BINOPS` with no value builds rung 1, which measures
 * 0 B — GCC folds a one-entry table back into a direct call, so the kernel does not even exist. A rung
 * below 10 silently measures the old code, which is why the value is written here and not passed ad hoc. */
#define P54_BINOPS 10
/* R4: SPAWN + the task driver. GUARDRAIL: tasks are stepped from run_line(), NOT from inside
 * vm_enter(): vm_switch overwrites the live machine, so a switch taken mid-dispatch would resume the
 * outer interpreter with a task's stacks. The outer VM is saved around the run for the same reason. */
/* GUARDRAIL: OFF. With P43_TASKS the tasks run and interleave correctly (`SPAWN TA SPAWN TB` with
 * PAUSE bodies printed 1 3 2 4), but afterwards the console replays stale command bytes and the REPL
 * is lost — measured with 376 B AND 556 B of C stack, so it is not stack overflow. Root cause not
 * found; do not re-enable until it is. The dictionary is baked: image.h must be regenerated with the
 * same P43_TASKS setting, or SPAWN's header points at a case that is not compiled. */
/* GUARDRAIL: 0 in the P52 bench build only. Tasks cost ~280 B of .bss and ~200 B of text, and the
 * shipping image has 3 B of pool; the scheduler is not in the interpreter's path, so leaving it out does
 * not change dispatch cost or any workload result — it buys the space the instrument needs. */
/* GUARDRAIL: UNDEFINED, not 0. Every guard in uforth.c is `#if defined(P43_TASKS)`, so `#define P43_TASKS 0` leaves the
 * scheduler compiled in - measured: the image was byte-identical with 0. The two notes above already say tasks are OFF
 * and must stay OFF (they lose the REPL) and that they cost ~280 B of .bss + ~200 B of text, so having this line defined
 * at all contradicted the file's own rules. Commented out; re-enable only together with the root cause. */
/* #define P43_TASKS 1 */
#if !defined(NODATA)
#define IMAGE
#endif
/* GUARDRAIL: F-167's probe switch. Dropping IMAGE leaves mem[] as .bss instead of 2 550 B of initialized .data - and
 * ".data == 0" is the ONLY structural fact that separates every working image from every failing one all session (the
 * reference ULP builds with data 0, ours with data MEMSZ+16). For the store probe the dictionary is not needed at all:
 * the witness is a pad bit, and main stores before anything else, so running without the baked dictionary is a valid
 * experiment rather than a broken machine. */
/* HW@ / HW! : absolute RTC-domain register access for Forth (F-149, docs/30 5b).
 * GUARDRAIL: measured at 62 B (image 7 891 -> 7 953) against a POOL of 7 892, so it is OFF. Funding it from the
 * stack reserve's measured slack (300 B reserved, 240 B high-water = 60 B) still leaves it 1 B short - the number is
 * recorded here so the next attempt starts from it instead of re-measuring. Turn it on only together with the bytes
 * that pay for it, and re-measure the high-water when the reserve drops. */
/* #define HWPRIMS 1 */

/* HW_GATE: the 64-byte RTC GPIO window opened in P() itself (F-149). Measured 12 B of .text, +29 B of stack high-water
 * (240 -> 269, painted, 0 B free), so ~41 B end to end against 12 B of room. Kept implemented and off. */
#define HW_GATE 1
/* -- measured shapes, none affordable (baseline image 7 891, POOL 7 892):
 *      gate inline inside P()            +42 B  (7 933)
 *      all of P() noinline               +12 B  (7 903)  but painted stack 240 -> 269 B (+29)
 *      fast path inline + P_slow noinline +38 B  (7 929)
 *   So the true price is ~40 B in every shape that leaves the stack alone, and the one cheap shape pays for it in stack.
 *   The machine has 1 B. The gate is implemented, correct and OFF; the day 40 B of real reclaim exists it is one flag. */

#if !defined(HOST)
/* GUARDRAIL: guarded by !HOST - the host build of this file has no ULP headers on its include path, and this include
 * would break tests/build_host_app.sh, which is the suite's foundation. */
#include "ulp_riscv_gpio.h"      /* F-162: the pads' clock gate is opened BY THE ULP here, as the reference does */
#endif
#include "uforth.c"

/* ---------------------------------------------------------------- rings */
/* GUARDRAIL: the rings are pool bytes, and the ULP drains only 32 command bytes per wake, so a 128 B
 * command ring held four wakes' worth of typing that no human can produce (a wake is 6.46 us). 64 B
 * still holds two, and a paste is bounded by it either way. GUARDRAIL: `pl_emit` DROPS when the output
 * ring is full rather than blocking, so shrinking 256 -> 128 makes `repl_out_drop` more likely to be
 * non-zero — keep that counter reachable, or a truncated reply will look like a wrong answer. */
#define CMD_SIZE 64u
#define OUT_SIZE 128u
#define CMD_MASK (CMD_SIZE - 1u)
#define OUT_MASK (OUT_SIZE - 1u)

/* GUARDRAIL: non-static, or the IDF map generator (nm -g) never emits the symbol and the HP side
 * cannot see the rings at all — which looks like "the ULP never ran". */
/* GUARDRAIL: the ring sizes are also compiled into the MAIN CORE (main/repl_main.c), and a mismatch
 * corrupts the console: with the ULP at 64 B and the host still masking with 127, the host wrote past
 * the end of repl_cmd[] into repl_out[] and the REPL replayed stale characters (`3 CUBE .H`,
 * `.HERE?`). Export the sizes so the host can assert them at boot instead of trusting a copy. */
volatile u32 repl_cmd_bytes = CMD_SIZE;
volatile u32 repl_out_bytes = OUT_SIZE;
volatile u8  repl_cmd[CMD_SIZE];
volatile u8  repl_out[OUT_SIZE];
volatile u32 repl_cmd_head;      /* written by the HP */
volatile u32 repl_cmd_tail;      /* written by the ULP */
/* GUARDRAIL: the drop counter is BACK, and the difference from last time is that the main core now READS it (`#u`).
 * It was deleted because "nothing on the ULP or the main core ever read it - it counted drops for nobody", which was a
 * statement about the reader, not about the counter. A byte that the ring could not hand over is gone with no other
 * symptom: the screen simply comes out short (measured - the reader lost the tail of every 70-column row until it was
 * paced, F-140). The counter costs a load/add/store on the hot path and 4 B of .bss, and it buys the one thing that makes
 * pacing verifiable: a number. The ring still DROPS rather than overwriting unread bytes - overwriting would serve the
 * host half a word, which is worse than losing it. */
volatile u32 repl_out_drop;      /* bytes dropped because the ring was full; zeroed at ULP boot */
volatile u32 repl_out_head;      /* written by the ULP */
volatile u32 repl_out_tail;      /* written by the HP */
volatile u32 repl_wake_count;
#if defined(ENGINE_TEST) && !defined(HOST)
volatile u32 eng_status;      /* published: only the HP core reads registers honestly (F-158) */
volatile u32 eng_rb;          /* the byte the C engine reads back out of the radio's own RAM */
/* GUARDRAIL: bit-banged with raw set/clear words, deliberately NOT calling the engine's spi_xfer()/hal_read(): that
 * chain costs ~500 B of text and the 7 932 B budget has no room at MEMSZ 2 180 (the link said so with "region ram
 * overflowed"), while MEMSZ cannot drop either because the baked prelude needs 2 052 B. Register writes only, one pad
 * bit per word, which is also the lesson F-176 measured: a word ORed from several pads is discarded whole.
 * Pads per docs/29: NSS 8 (bit 18), SCK 9 (bit 19), MOSI 10 (bit 20), MISO 11 (bit 21 in RTC_GPIO_IN). */
/* GUARDRAIL: bit-banged with raw set/clear words, deliberately NOT calling the engine's spi_xfer()/hal_read(): that
 * chain costs ~500 B of text and the 7 932 B budget has no room (the link said so with "region ram overflowed" at
 * every MEMSZ that still fitted the baked prelude and a loaded driver). Two things brought it down from 468 B to
 * ~180: ONE shared 8-bit helper instead of three inline loops, and hoisting the three register addresses into
 * pointer locals instead of letting each ENG_SET/ENG_CLR expansion materialise its own 32-bit literal pool.
 * GUARDRAIL: one pad bit per set/clear word - a word ORed from several pads is discarded whole (F-176 measured it).
 * Pads per docs/29: NSS 8, SCK 9, MOSI 10, MISO 11; OUT data starts at bit 10, so these are bits 18/19/20/21. */
/* GUARDRAIL: these probes must use the coprocessor's OWN alias window (esp32s3.peripherals.ld: RTCIO = 0xA400),
 * not the SoC address. Absolute 0x600084xx loses A10/A11 for this core, so a probe written that way could only
 * ever observe its own failure - which is what every "#z does nothing" result meant. */
#define ENG_W1TS ((volatile u32 *)0xA404u)
#define ENG_W1TC ((volatile u32 *)0xA408u)
#define ENG_IN   (*(volatile u32 *)0xA424u)
static u32 eng_x8(u32 out)                 /* one byte out, one byte in, MSB first, mode 0 */
{
    u32 v = 0u;
    for (int b = 7; b >= 0; b--) {
        if ((out >> b) & 1u) { *ENG_W1TS = (1u << (10 + 10)); }
        else                 { *ENG_W1TC = (1u << (10 + 10)); }
        *ENG_W1TS = (1u << (9 + 10));      /* SCK rises with data valid */
        v <<= 1;
        if (ENG_IN & (1u << (11 + 10))) { v |= 1u; }
        *ENG_W1TC = (1u << (9 + 10));
    }
    return v;
}
static u32 eng_rb_read(void)
{
    u32 v;
    *ENG_W1TC = (1u << (8 + 10));          /* NSS low */
    (void)eng_x8(0x1Eu);                   /* ReadBuffer */
    (void)eng_x8(0u);                      /* offset 0 */
    (void)eng_x8(0u);                      /* dummy */
    v = eng_x8(0u);                        /* the radio's own byte */
    *ENG_W1TS = (1u << (8 + 10));          /* NSS high */
    return v;
}
volatile u32 eng_dio1;
#endif
/* GUARDRAIL: see the probe in main(). `go` is written by the HP core, `res` by the ULP; neither is read by the
 * same side that writes it, which is what makes this a two-reader measurement rather than an echo. */
volatile u32 pl_hwgo;      /* the SENS value the ULP read */
volatile u32 pl_hwres;     /* the RTCIO OUT value the ULP read */
volatile u32 pl_hwcnt;     /* wakes since load */
/* GUARDRAIL: KEY needs its OWN queue. It used to read the interpreter's command ring, so a program that called KEY
 * consumed the text of the very line that started it - measured: `KEY .` answered 75, the 'K' of "KEY", and a
 * full-screen app could never receive a keystroke. This cell is written by the main core in raw mode and drained by
 * pl_key; the interpreter's ring is never touched by either.
 * GUARDRAIL: 0xFFFFFFFF means EMPTY and is initialised in .data, not .bss: .bss is not part of the ULP binary, so a
 * zero-initialised "empty" marker would read as a real key (0x00) after a fresh load.
 * GUARDRAIL: one slot, so a keystroke arriving while it is still full is DROPPED rather than queued. Typing into a
 * menu cannot outrun a 6.5 ms wake; a paste can, and that loss is visible rather than silently reordered. */
/* GUARDRAIL: ONE published cell is enough for keys, because the HOST queues what the program has not taken yet (see the
 * raw path in repl_main.c). A ring here was the first idea and lost the middle byte of escape sequences instead: three
 * bytes arriving inside one 6.5 ms wake cannot be delivered one-at-a-time through a single slot, so the HOST must hold
 * them, and it can - it is not the constrained side. 0xFFFFFFFF means empty and lives in .data, not .bss. */
volatile u32 repl_keybox = 0xFFFFFFFFu;   /* written by the HP (raw mode), drained by pl_key */
/* GUARDRAIL: the line/error counters are gone. Both were incremented (per line, per error) and reset at
 * boot, and NOTHING read them — not the HP, not the suite, not the bench, not any tool in the tree. Same
 * class as the depth counters and the switch counters: an increment whose value nobody reads is pure cost
 * (a load, an add, a store per event, plus 4 B of .bss each). `repl_status` deliberately STAYS: it is the
 * only record of why the ULP halted, and the right fix for a diagnostic nobody reads is to make the HP read
 * it, not to delete it. */
/* GUARDRAIL: repl_out_drop is GONE, and the distinction matters: the comment above says the right fix for
 * a diagnostic nobody reads is to make the HP read it — which is why repl_status stays — but a byte counter
 * is not that kind of diagnostic. Nothing on the ULP or the main core ever read it (it was exported and
 * declared in the generated ulp_main.h, which is what made it look used), so it counted drops for nobody
 * while costing a load, an add, a store AND 4 B of .bss on a path that runs for every emitted byte.
 * GUARDRAIL: the ring still DROPS rather than overwriting unread bytes — that behaviour is unchanged and
 * must stay: overwriting would silently serve the host half a word, which is worse than losing it. If this
 * ever needs to be visible again, the loud channel is pl_halt() (repl_status), not a counter. */
volatile u32 repl_status;        /* 1 = booted, 0xE0+rc = error, see below */

/* GUARDRAIL: .bss is not in the ULP .bin (load_binary writes .text/.rodata/.data only), so an
 * uninitialised static holds whatever the previous image left behind. A zero-initialised variable
 * also lands in .bss, so the "have I run before?" flag is a NON-zero magic in .data. */
static volatile u32 repl_magic = 0x52455000u;    /* 'REP.' */
#define REPL_MAGIC_RAN 0x52455001u

/* ---------------------------------------------------------------- hooks */
void pl_emit(int c)
{
    u32 h = repl_out_head;
    u32 t = repl_out_tail;
    if ((h - t) >= OUT_SIZE) { repl_out_drop = repl_out_drop + 1u; return; }  /* full: drop and COUNT it */
    repl_out[h & OUT_MASK] = (u8)(c & 0xff);
    repl_out_head = h + 1u;
}

/* The REPL reads raw bytes from cmd[] itself, so KEY has nothing to do. -1 is what an empty caller
 * returns, so a program using KEY sees "no input" rather than a stall. */
/* GUARDRAIL: KEY was a STUB returning -1, and KEY? read a hardware register that is always 0. A Forth program could
 * therefore never read a keystroke: every menu had to be driven from the host, which is exactly what makes a terminal
 * program not a terminal program. In RAW mode the host forwards bytes as they arrive (no line assembly), and the program
 * consumes them here, advancing the same ring tail the interpreter uses - safe because the interpreter is blocked inside
 * the running program, not reading tokens.
 * GUARDRAIL: return -1 when empty, never block. Forth polls with `BEGIN KEY DUP -1 = WHILE DROP REPEAT`, which keeps the wake loop
 * free to service the block store; a blocking KEY would hold the ULP inside one wake and starve block I/O. */
int pl_key(void)
{
    u32 v = repl_keybox;
    if (v == 0xFFFFFFFFu) return -1;            /* nothing typed yet */
    repl_keybox = 0xFFFFFFFFu;                  /* consume: one keystroke, one read */
    return (int)(v & 0xffu);
}

int pl_keyq(void) { return (repl_keybox != 0xFFFFFFFFu) ? 1 : 0; }

/* MS: wait a real number of milliseconds. This used to be `return repl_wake_count;` - a stub that returned at once,
 * measured as twenty `200 MS` in 0.05 s, which is why a demo "paced" by it ran at ~267 frames/s and walked its counter
 * into the console's message-code space (F-124, F-125).
 *
 * GUARDRAIL: the clock is `rdcycle`, not the RTC timer. `rdcycle` is one instruction, is already the harness's time
 * source (p39_cyc_start), and needs no register latch; the RTC timer would cost the latch dance (~20 B) out of the
 * 53 B of pool headroom this image has left, for a resolution a busy-wait cannot use.
 * GUARDRAIL: the constant is 19 000 cycles/ms because P05 MEASURED the core at 19.0 MHz +/- 1.5 % on this board. It is
 * not derived from a Kconfig number, because the ULP's clock has never been the number the config file claims.
 * GUARDRAIL: the wait is per-millisecond, `while (a--)` around a 19 000-cycle gate. `a * 19000` would overflow u32 for
 * a > 226 050 and silently shorten the wait - a fail-safe that turns a bad argument into a quiet success. The loop
 * cannot overflow, and `a` = 0 waits for nothing, which is the honest reading of `0 MS`.
 * GUARDRAIL: this is a SPIN, and it must be documented as one: during it the ULP services nothing - no key, no block
 * request - because the machine has one execution context. Keep sleeps short; a wait longer than BLKWAIT (~845 ms)
 * would starve a block request that is already outstanding. A true sleep needs the wake timer, which is a different
 * mechanism (WAKE hands the wake back to the scheduler, this does not). */
#define CYC_PER_MS 19000u

static inline u32 cyc_now(void)
{
    u32 c;
    __asm__ volatile ("rdcycle %0" : "=r"(c));
    return c;
}

u32 pl_hw(int op, u32 a, u32 b)
{
    (void)b;
    if (op == 3) {
        u32 ms = a;
        while (ms--) {
            const u32 t0 = cyc_now();
            while ((u32)(cyc_now() - t0) < CYC_PER_MS) { }
        }
        return 0;
    }
    return 0;
}

void pl_halt(int code) { repl_status = 0x100u + (u32)code; }

/* ---------------------------------------------------------------- REPL */
/* GUARDRAIL: no string emitter here any more. Each message is ONE byte (msg(), uforth.c) that
 * main/repl_main.c expands, so the ULP carries no message text and no string loop. The byte occupies
 * exactly the ring position the text used to, which keeps the operator's transcript and its ordering
 * against the echoed input byte-identical. */


/* One typed line: interpret it, then print the outcome.
 * GUARDRAIL: interpret() consumes tib[0..tl) and stops at tl — it does not wait for a newline, which
 * is why the newline is consumed here and tl reset before the call. */
static void run_line(void)
{
    tl = ti;
    ti = 0;
    /* GUARDRAIL: start every line on an EMPTY stack. `.bss` is not part of the ULP binary, and `repl_magic` lives in RTC
     * RAM that survives a reset - so after flashing a new image the first-run init is skipped and sp/rsp keep the
     * PREVIOUS image's values. Measured: the very first command after a reset answered ERR_STACK, because a stale sp of
     * ~200 fails PUSH's `sp < SD` check. A REPL line is a complete unit (nothing legitimately carries a data stack from
     * one line to the next), so zeroing here is both correct and the cheapest fix: it costs two stores and kills the
     * whole "stale RTC state leaks into your first keystroke" class. */
    sp = 0;
    rsp = 0;
    /* GUARDRAIL: `stack_ovf` is a .bss flag that also survives in RTC RAM; if the previous image left it set, the FIRST
     * line of the new image reports ERR_STACK even though its own stack is fine (measured exactly that). Clearing it at
     * the line boundary makes the flag describe this line, not the last image's. */
    stack_ovf = 0;
    interpret();
    if (errf) {
        /* GUARDRAIL: the engine's err() already printed the offending word and '\n'. Printing
         * another message here produced "BOGUS?\n ?\n" — two reports for one error, which teaches
         * a user to distrust both. The engine's report is the one that names the word, so it wins. */
    } else if (sp >= SD) {
        msg(MSG_UNDERFLOW);
        sp = 0;
        rsp = 0;
    } else {
        msg(MSG_OK);
    }
    tl = 0;
    ti = 0;
}

/* Pull at most CMD_BUDGET bytes per wake: enough for typing, small enough that a paste cannot make
 * one wake run for a whole period. The rest stays in the ring for the next wake. */
#define CMD_BUDGET 32u

/* ---------------------------------------------------------- P42 bench ----
 * GUARDRAIL: built only with -DP42_BENCH. The first version was always-on and left the machine
 * answering nothing: input echoed, replies arrived late and batched, and the bench reported
 * `min=567 err=4` for 100 repetitions of a 54-token line. A diagnostic that breaks the machine it
 * measures costs a flash cycle per iteration and invalidates every number it produces, so the
 * default build must not contain it. P42's measurement is therefore still OPEN (RESULT.md). */
#ifdef P42_BENCH_ATTEMPT1_DEAD   /* kept as a record only: see probe-results/P42-RESULT.md */
/* GUARDRAIL: nothing inside this #ifdef has compiled since P42 was abandoned, and its echo(...) calls now
 * name a function that no longer exists (messages are one-byte codes, msg_codes.h). It is prose with line
 * noise, kept for the numbers it records — do not build it and do not copy its echo() calls into live code. */
 * One fixed line, run BENCH_REPS times, minimum cycle count reported. The workload is deliberately
 * dumb: a counted BEGIN..UNTIL over prelude words, so nothing but the token fetch differs between
 * the two images being compared (same prelude, same primitives, same text, same count).
 *
 * GUARDRAIL: never compare two builds by counting instructions. P14 measured NEXT at 480 cycles for
 * ~20 instructions — ~24 cycles per instruction — so RTC RAM latency, not opcode count, decides.
 * Only rdcycle on the same workload across two images can answer "did the fetch get faster".
 *
 * GUARDRAIL: keep the bench OUTSIDE the dispatch loop. A token counter inside interpret() would
 * perturb the very cycles being measured; the comparison stays valid only because the workload, not
 * the instrumentation, is what differs. */
#ifndef BENCH_TAG
#define BENCH_TAG "p42 base"
#endif
/* GUARDRAIL: no BEGIN/UNTIL here. They are compile-only: typed at the interpreter they silently do
 * nothing useful (measured: `3 BEGIN 1- DUP 0 = UNTIL DROP .` printed `3`, and P42's first run
 * reported 141 684 cycles for what should have been 1 000 iterations). A benchmark that quietly runs
 * once measures nothing, so the workload is a straight line of stack-neutral groups instead:
 * 9 x `1 DUP + DROP` = 117 chars (fits TIBSZ 128), stack-neutral, no control flow. */
#define BENCH_SRC  "1 DUP + DROP 1 DUP + DROP 1 DUP + DROP 1 DUP + DROP 1 DUP + DROP 1 DUP + DROP 1 DUP + DROP 1 DUP + DROP 1 DUP + DROP "
#define BENCH_REPS 100

volatile u32 repl_bench_min;
volatile u32 repl_bench_last;
volatile u32 repl_bench_sp, repl_bench_rsp, repl_bench_err;

/* Print one number with the engine's own '.' — the ULP has no libc formatter. Clears errf first so a
 * previous failure cannot suppress the diagnostic we are asking for. */
static void saynum(u32 v)
{
    errf = 0; sp = 0; rsp = 0;
    ds[0] = v; sp = 1u;
    tib[0] = '.'; tib[1] = ' '; tl = 2u; ti = 0u;
    interpret();
    tl = 0u; ti = 0u; sp = 0;
}

static u32 bench_once(void)
{
    u32 t0, t1, i;
    for (i = 0; i < (u32)(sizeof BENCH_SRC - 1); i++) tib[i] = (u8)BENCH_SRC[i];
    tl = (u8)(sizeof BENCH_SRC - 1);
    ti = 0;
    sp = 0; rsp = 0;                  /* a bench starts from a known machine, not from the caller's */
    __asm__ volatile ("rdcycle %0" : "=r"(t0));
    interpret();
    __asm__ volatile ("rdcycle %0" : "=r"(t1));
    repl_bench_sp = sp; repl_bench_rsp = rsp; repl_bench_err = (u32)errf;
    tl = 0; ti = 0;
    return t1 - t0;
}

static void bench_run(void)
{
    u32 rep, best = 0u;
    for (rep = 0; rep < BENCH_REPS; rep++) {
        u32 c = bench_once();
        repl_bench_last = c;
        if (rep == 0u || c < best) best = c;
    }
    repl_bench_min = best;
    /* GUARDRAIL: fail loud on a dirty stack. A bench that silently leaked a cell per iteration would
     * report a beautiful number for a workload that stopped being the same workload. */
    echo("\n" BENCH_TAG " min="); saynum(best);
    echo(" err="); saynum(repl_bench_err);
    echo(" sp=");  saynum(repl_bench_sp);
    echo(" rsp="); saynum(repl_bench_rsp);
    /* GUARDRAIL: fail loud on a dirty stack, but report the numbers first. P42's first run said only
     * "stack/err dirty" and cost a rebuild+reflash to learn nothing; a diagnostic that withholds the
     * values it already has is a second bug. */
    if (repl_bench_err || repl_bench_sp != 0u || repl_bench_rsp != 0u) {
        echo("\nbench: DIRTY, cycles void\n"); return;
    }
    echo("\n");
}

static int is_bench_line(void)
{
    return ti == 5u && tib[0] == 'B' && tib[1] == 'E' && tib[2] == 'N' && tib[3] == 'C' && tib[4] == 'H';
}
#endif /* P42_BENCH */

#ifdef P52_LINECYC
/* ------------------------------------------------- P52 line cycle records ----
 * GUARDRAIL: the instrument sits OUTSIDE the path it measures. rdcycle is read at the LINE BOUNDARY in
 * drain_cmd(), never inside interpret() or vm_enter(): P42 attempt 1 put instrumentation in the dispatch
 * loop and invalidated every cycle it reported. Two reads per line against a ~1e6-cycle workload is noise.
 * GUARDRAIL: publish the record count LAST. The host prints a slot only when the count says it is new, so a
 * count written before its values would print a half-written record — the same write-status-last rule the
 * block mailbox already follows. A "" ::: "memory" barrier keeps the compiler from sinking the stores.
 * GUARDRAIL: no record array. The first version kept 8 (cycles, dispatches) slots so the host could read them
 * later, and that cost 68 B of .bss for a buffer nothing read — the values are printed straight from locals
 * immediately after the bracket closes, which is also the only way to keep them attributable to the line that
 * produced them. Publishing the count LAST stays the rule for anything that does get published. */
static u32 linec_t0, lined_t0;

/* GUARDRAIL: the ULP has no libc formatter, so a number is printed by the ENGINE: push it, then interpret
 * ".". That costs ~1 600 cycles and therefore runs AFTER the bracket closes — never inside it. */
static void saynum(u32 v)
{
    errf = 0; sp = 0; rsp = 0;
    ds[0] = v; sp = 1u;
    tib[0] = '.'; tib[1] = ' '; tl = 2u; ti = 0u;
    interpret();
    tl = 0u; ti = 0u; sp = 0;
}

static void line_bench_begin(void)
{
    __asm__ volatile ("rdcycle %0" : "=r"(linec_t0));
    lined_t0 = p42_dispatches;
}

static void line_bench_end(void)
{
    u32 c, cyc, dsp;
    __asm__ volatile ("rdcycle %0" : "=r"(c));
    cyc = c - linec_t0;
    dsp = p42_dispatches - lined_t0;
    /* marker on its own line: "C <cycles> D <dispatches>" — the driver parses exactly this */
    pl_emit('\n'); pl_emit('C'); pl_emit(' '); saynum(cyc);
    pl_emit('D'); pl_emit(' '); saynum(dsp); pl_emit('\n');
}
#endif /* P52_LINECYC */

static void drain_cmd(void)
{
    u32 t = repl_cmd_tail;
    u32 h = repl_cmd_head;
    u32 n = h - t;
    u32 i;

    if (n > CMD_BUDGET) n = CMD_BUDGET;

    for (i = 0; i < n; i++) {
        u8 c = repl_cmd[(t + i) & CMD_MASK];
        if (c == '\r' || c == '\n') {
            pl_emit('\n');
#ifdef P52_LINECYC
            line_bench_begin();
#endif
            run_line();
#ifdef P52_LINECYC
            line_bench_end();
#endif
        } else if (c == 8 || c == 127) {
            if (ti > 0) { ti--; msg(MSG_ERASE); }
        } else if (c >= 32 && c < 127) {
            if (ti < TIBSZ - 1) { tib[ti++] = c; pl_emit(c); }
            else { msg(MSG_LINE_TOO_LONG); tl = 0; ti = 0; }
        }
        /* other control bytes are ignored and not echoed, by design (06-repl.md §4) */
    }
    repl_cmd_tail = t + n;
}

/* P42 bench, attempt 2 — included after uforth.c so it sees the engine's internals, and only in a
 * bench build. GUARDRAIL: called from main() at boot, never from inside the drain path. */
#ifdef P42_BENCH
#include "p42_bench.inc"
#endif

#if defined(ULP_HAL) && !defined(HOST)
/* GUARDRAIL: F-176b - the DECISIVE experiment, and the reason F-175 could not answer it. hal_init() compiled from
     * the reference file itself, in our image, called before our own store. If bit 23 (pad 13, an HP-side input that
     * nothing else writes) comes back SET, the coprocessor CAN reach RTCIO and every earlier "environmental block"
     * conclusion is wrong; if it stays clear with the working engine running first, the block is in this app, not in
     * the program - which is a different investigation and a shorter one. */
#include "hal_engine.h"   /* LORA_PIN_* and the prototypes */
#endif
#if defined(ENGINE_TEST) && !defined(HOST)
#include "hal_engine.h"
#endif

int main(void)
{
#if defined(ULP_HAL) && !defined(HOST)
    /* GUARDRAIL: F-176i - the ladder is retired (its text now lives in docs/30, not here): output_enable alone LOST,
     * init+enable for one pad LOST, all seven configured with no level writes LOST, a burst of stores LOST. What LANDED
     * was hal_init() complete, compiled from the reference file. So this block calls the engine and then, immediately
     * after, issues ONE store from our own image's code to SCK (bit 19), which the engine drives LOW: a SET bit 19 can
     * only come from my instruction. GUARDRAIL learned the hard way two turns ago: do not retire a switch by wrapping it
     * in `#if 0` when the working call sits in its `#else` - the call is then silently dropped too, and the verdict reads
     * off a build that no longer contains the thing under test (text 4 984 vs 5 220 is what told me so). */
    hal_init();
#endif
#if defined(ENGINE_TEST) && !defined(HOST)
    /* GUARDRAIL: ENGINE_TEST is the control experiment, the only way to split the two live hypotheses. The Forth bus
     * probe reads 0 for every byte the radio is asked to echo (tests/lora_bus.py): either the coprocessor's pad writes
     * never move the pins, or they do and MISO cannot be read back. Running the reference engine's OWN C code -
     * hal_reset() then GetStatus over hal_read() - inside this image answers that with a number rather than a guess,
     * and it is published to the HP core because only the HP core reads registers honestly (F-158). */
    eng_rb = eng_rb_read();
    /* GUARDRAIL: report through the coprocessor's OWN console path (echo + saynum, the same pair the bench uses). The
     * alternative - referencing ulp_repl_eng_* from the app - fails at the HP build, because ulp_embed_binary publishes
     * a fixed symbol set and silently omits anything new, so the app just does not compile. */
    /* GUARDRAIL: emit with pl_emit alone. echo()/saynum() are not visible at this point in the translation unit (they
     * live inside the bench region behind its own guards), and an implicit declaration is a build failure at best and a
     * silent wrong-number print at worst. Hex digits by hand, through the one function that never blocks. */
    {
        /* GUARDRAIL: print ONCE and print it right. An unguarded per-wake report floods the console at 24 groups a
         * second, and every Forth reply then reads as garbage (measured: `IN after` returned the middle of another
         * wake's digits). One line, one prefix, eight digits per value. */
        /* GUARDRAIL: one byte per wake, two hex digits, prefixed. The previous version printed 24 groups per wake and
         * flooded the console so every Forth reply came back as another wake's digits; a report that destroys the
         * transcript is not a report. One line per wake, and wakes happen once per console line. */
        const char hx[] = "0123456789ABCDEF";
        /* GUARDRAIL: one report per wake, two digits, nothing else - the earlier version printed three 32-bit
         * values per wake, which both flooded the console and cost ~200 B of text that the 7 932 budget does not
         * have. The only number this probe needs is the byte the engine read back out of the radio. */
        pl_emit('\n'); pl_emit('R'); pl_emit('=');
        pl_emit(hx[(eng_rb >> 4) & 0xFu]);
        pl_emit(hx[eng_rb & 0xFu]);
        pl_emit('\n');
        (void)eng_status;   /* retired with hal_reset(): the readback alone answers the question */
        (void)eng_dio1;
    }
#endif

#if defined(ULP_PAD_OWNERSHIP) && !defined(HOST)
    /* GUARDRAIL: F-175 - the fix the inverse bisect found. probe/lora's hal_init() is the gate (deleting it LOSTs, and
     * deleting only its three level writes LOSTs while deleting only the pull operations LANDED), so the requirement is:
     * THE COPROCESSOR MUST CONFIGURE ITS OWN PADS AND DRIVE THEIR LEVELS. Handing the pads over from the HP core is not
     * enough - which is exactly why every store from this firmware was discarded for the whole investigation while the
     * reference image, booted by the very same app, drove the same pad fine. Run it once, on the first wake: a loop over
     * the 7 SPI pads plus the three idle levels, sized to the bytes the pool can spare.
     * GUARDRAIL: this must be unconditional on the ULP side. Doing it from `lora_pads_setup()` on the HP core was tried
     * first and measures as LOST (F-162, F-175) - the clock/mux ownership is per-master. */
    {
    /* GUARDRAIL: automatic, not static const. The ULP linker folds the image into RTC slow memory and a file-scope const
     * array got placed outside the range its 16-bit-encoded absolute relocs can reach, which the linker reported as
     * "external relocation ... but no symbol". A local array sits on the ULP stack, in range, and the list is written
     * once per wake, which costs nothing the driver cares about. */
    u8 lora_pads[7] = { 9, 10, 8, 12, 11, 13, 14 };   /* SCK MOSI NSS RST MISO BUSY DIO1, as the C driver */
        for (u32 i = 0; i < 7u; i++) ulp_riscv_gpio_init(lora_pads[i]);
        ulp_riscv_gpio_output_enable(9);   ulp_riscv_gpio_output_enable(10);
        ulp_riscv_gpio_output_enable(8);   ulp_riscv_gpio_output_enable(12);
        ulp_riscv_gpio_input_enable(11);   ulp_riscv_gpio_input_enable(13);
        ulp_riscv_gpio_input_enable(14);
        *(volatile u32 *)0xA404u = (1u << (8 + 10)) | (1u << (12 + 10));   /* NSS, NRST high */
        *(volatile u32 *)0xA408u = (1u << (9 + 10));                        /* SCK low        */
    }
#endif   /* ULP_PAD_OWNERSHIP */
#if defined(HWPROBE)
    /* GUARDRAIL: PAD 8 (bit 18), the output pad this firmware enables - not pad 11, which is INPUT_ONLY here so its OUT
     * data bit is not a meaningful target (that mistake made one whole bisect round inconclusive). The baseline trap (R18)
     * is handled on the HP side, which clears the bit after arming the coprocessor and watches it come back. */
    /* GUARDRAIL: F-162. The reference ULP calls ulp_riscv_gpio_init() on every pad BEFORE touching a pin, and this
     * firmware has always configured the pads from the HP core and skipped it. That helper's first statement is a
     * SET_PERI_REG_MASK on SENS_SAR_PERI_CLK_GATE_CONF_REG (bit 31, the RTC IO MUX clock) executed *by the ULP*: the
     * clock-enable may be per-master, so an HP-side set of the same bit would not open the ULP's own path - which would
     * explain every symptom (HP sees its own writes, the ULP's reads and writes vanish, and the difference between the
     * two firmwares is invisible in every dump because the register reads the same). */
    /* GUARDRAIL: F-176 - set TWO bits, not one: bit 18 (pad 8/NSS, an HP-configured output) and bit 23 (pad 13/BUSY,
     * an HP-side input whose OUT data bit nothing in this firmware writes). If the coprocessor's store reaches the
     * register at all, bit 23 proves it; if only bit 18 fails, the earlier 165 probes were watching a contested bit. */
    /* GUARDRAIL: F-176f - ONE pad bit per W1TS word. The two-bit witness I just added is what made this build lose:
     * in the LANDED run bit 18 came back SET while bit 23 stayed CLEAR, i.e. the store that ORed both never landed
     * at all and bit 18 was set solely by hal_init's own single-bit pin_high(). On this core a set/clear word that
     * includes a pad whose output path is not enabled is discarded as a whole, so a "witness" bit on an input pad is
     * not free evidence - it poisons the very write it is watching. Never OR unrelated pads into one word. */
    /* GUARDRAIL: F-176g - the last asymmetry between the working image and this one is COUNT: hal_init issues three
     * level stores (NSS, RESET, SCK) and lands; one store to the same address with the same value, after the same
     * configuration, does not. If the coprocessor's write buffer needs a companion transaction to drain, repeating
     * the store is the fix, and the Forth driver has to follow every pad write with a second one. */
    /* GUARDRAIL: never name a local `w` or `ip` in anything that includes uforth.c - the VM does `#define w (V->W)` and
     * `#define ip (V->IP)` at file scope, so the identifier silently expands and the build fails with nonsense
     * ("invalid type argument of unary '*'" and a cascade inside vm_enter). That cost one build cycle here. */
    /* GUARDRAIL: F-176h - the confound-free witness. Let the WORKING engine configure and drive the pads, then issue
     * exactly one store from THIS image's own code to SCK (bit 19), a pad the engine deliberately drives LOW, so a SET
     * bit 19 can only have come from my instruction. bit 18 (NSS) is the engine's own write and bit 23 (BUSY, never
     * output-enabled) is the control that must stay clear. If bit 19 comes back SET, our stores reach RTCIO after all
     * and every earlier "lost" was about the pad or the value, not about the coprocessor being unable to write. */
    *(volatile u32 *)0xA404u = (1u << (9 + 10));   /* SCK high - the engine leaves it low */
    /* GUARDRAIL: witness on MOSI (pad 10, bit 20), not NSS: the HP core idles NSS and NRST HIGH at boot, so a SET
     * observed on those pads cannot be told apart from the boot value. MOSI and SCK are idled low, so a single store
     * from the coprocessor either moves the register or it does not, with no ambiguity. One pad per word (F-176). */
    *(volatile u32 *)0xA404u = (1u << (10 + 10));
    *(volatile u32 *)0xA404u = (1u << (9 + 10));
    /* GUARDRAIL: a replacement that starts mid-line must end mid-line: gluing this comment onto the store turned every
     * following line into a comment continuation and the build failed on "unterminated comment" - check the tail of a
     * generated edit, not just its head (same family as the glued `#else` and the swallowed newline).
     * F-166: hold the coprocessor awake for ~1 ms AFTER the store. A ULP peripheral write
     * is posted, and `ulp_riscv_halt()` right after it gates the ULP's bus before the write reaches the APB - which is
     * exactly why the reference image (whose wake lasts 195 ms of SPI after the same store) lands and our probe (which
     * stores and returns within microseconds) does not, and why every content bisect - size, .data, preamble, flags,
     * config, placement - failed to flip the answer. */
    {   /* GUARDRAIL: spin on rdcycle, the way MS() already does on this core (1 ms at the measured 17.5 MHz). */
        u32 t0, t;
        asm volatile("rdcycle %0" : "=r"(t0));
        do { asm volatile("rdcycle %0" : "=r"(t)); } while ((t - t0) < 17500u);
    }
    *(volatile u32 *)0xA404u = (1u << (8 + 10));   /* and again after the delay, still one bit per word */
    /* GUARDRAIL: count this wake, or the HP side cannot tell "the probe ran and the store was lost" from "this image never
     * ran at all" - which is exactly how two earlier bisect results became void (F-159). The liveness counter must be in
     * the same image as the experiment. */
    repl_wake_count = repl_wake_count + 1u;
    /* GUARDRAIL: keep every symbol the HP side links against. With P42_ONLY the interpreter is not linked, so
     * --gc-sections drops the variables it used and the app fails with "'ulp_repl_mem_addr' undeclared" - which reads
     * like a CMake error and is the linker doing its job. Same trick, same reason, as src/ulp_stub.c. */
    {
        volatile u32 keep;
        keep = (u32)&repl_cmd[0];      keep = (u32)&repl_out[0];
        keep = (u32)&mailbox[0];       keep = (u32)&mem[0];
        /* GUARDRAIL: ASSIGN these, do not merely reference the arrays. The real path publishes the offsets after the
         * P42_ONLY return, so with the bench build the variables were published by nothing and --gc-sections dropped
         * them - the app then failed on 'ulp_repl_mem_addr undeclared'. Referencing &mem[0] keeps mem[], not the offset. */
    #if defined(ENGINE_TEST) && !defined(HOST)
    eng_status_addr = (u32)&eng_status;      /* published for the HP core, the only honest reader (F-158) */
    eng_self_addr = (u32)&eng_selftest;
    eng_dio1_addr = (u32)&eng_dio1;
#endif
    repl_mem_addr = (u32)&mem[0];
        repl_mb_addr  = (u32)&mailbox[0];
        repl_blk_off  = (u32)BLKADR;
        repl_blk_sz   = (u32)BLKSZ;
        keep = (u32)BLKADR;            keep = (u32)BLKSZ;
        keep = repl_blk_out;           keep = repl_blk_req;
        keep = repl_blk_off;           keep = repl_blk_sz;
        keep = repl_cmd_bytes;         keep = repl_out_bytes;
        keep = repl_status;            keep = repl_out_drop;
        keep = repl_keybox;
        (void)keep;
    }
#endif
                                       /* wakes since load: proof the probe ran */
    /* GUARDRAIL: no rdcycle at wake entry. It fed `repl_cyc_start`, which was written on EVERY wake and
     * read by nothing in this tree (the only similar reader is p39_main.c, which reads a different variable
     * in the P39 probe). An rdcycle plus a store per 6.46 ms wake for a value nobody reads is pure cost —
     * the same audit that removed the depth, switch, line and block-error counters. */
    /* GUARDRAIL: the baked image carries absolute addresses (V_LATEST is the header area's base), so an
     * image baked at a different MEMSZ is not merely stale — it points outside mem[]. Check the shape
     * before the first lookup, because the failure mode otherwise is "every word is unknown" and it looks
     * like a broken interpreter rather than a bad image. */
    image_boot_assert();

    /* GUARDRAIL: keep the magic guard. `main()` is re-entered on EVERY wake (measured: making this unconditional printed
     * the banner once per 6.5 ms), so the guard is what makes this "first wake after load" rather than "every wake".
     * GUARDRAIL: but the magic lives in RTC RAM and survives a reset, so after loading a NEW image this block is SKIPPED
     * and .bss (rings, block state, overflow flag, stack pointers) still holds the previous image's values - measured as
     * ERR_STACK and ERR_DIRTY on the first command after a fresh flash. cli.py absorbs that one line at connect time,
     * and the clears below run whenever init does happen. */
    if (repl_magic != REPL_MAGIC_RAN) {
        repl_magic = REPL_MAGIC_RAN;
        repl_cmd_head = 0; repl_cmd_tail = 0;
        repl_out_head = 0; repl_out_tail = 0; repl_out_drop = 0;
        repl_wake_count = 0;
        repl_status = 1;
        tl = 0; ti = 0; sp = 0; rsp = 0;
        /* GUARDRAIL: the block layer and the overflow flag are .bss too. A stale dirty flag made the first `BLOCK` answer
         * ERR_DIRTY and a stale overflow flag made the first line answer ERR_STACK. Reset them with everything else. */
        stack_ovf = 0;
        blkvars[0] = 0; blkvars[1] = 0;
        /* GUARDRAIL: these two globals exist for the MAIN CORE to compare against its own constants,
         * so nothing on the ULP reads them and --gc-sections deletes them — the host then fails to
         * build with "'ulp_repl_cmd_bytes' undeclared". Asserting them here is a real check (the
         * exported value must describe the arrays that exist) and keeps them alive. */
        if (repl_cmd_bytes != (u32)sizeof repl_cmd || repl_out_bytes != (u32)sizeof repl_out)
            pl_halt(0x60);
        msg(MSG_BANNER);     /* GUARDRAIL: the prompt must arrive from the ULP itself, so
                                        * "the HP printed it" can never be mistaken for "Forth ran". */
#ifdef P42_BENCH
#ifdef P42_ONLY
        /* GUARDRAIL: a bench-only main never reads the command ring, so --gc-sections deletes it and the
         * IDF map generator stops exporting ulp_repl_cmd — the main core then fails to build with
         * "'ulp_repl_cmd' undeclared", which reads like a CMake error. Keep one real reference. */
        repl_cmd[0] = repl_cmd[0];
#endif
        p42_run();                  /* once, at boot — never inside the drain (P42 attempt 1) */
#endif
    }

#ifdef P42_ONLY
    /* bench image: report once and retire. drain_cmd()/run_line() are then unreferenced and
     * --gc-sections removes them, which is what keeps this image inside the 7 856 B pool. */
    return 0;
#else
    /* GUARDRAIL: republished on EVERY wake, not once. `repl_magic` lives in RTC RAM, which survives a
     * reset, so after flashing a new image the first-run block is skipped and the host reads the PREVIOUS
     * image's addresses — measured: the block size read 0, every SAVE nacked with a bogus +4, and no byte
     * ever moved. Four stores per wake is nothing against handing the host a wrong pointer.
     * GUARDRAIL: these are OFFSETS into RTC slow memory; the host adds SOC_RTC_DATA_LOW. */
    repl_mem_addr = (u32)&mem[0];
    repl_blk_off  = (u32)BLKADR;
    repl_blk_sz   = (u32)BLKSZ;
    repl_mb_addr  = (u32)&mailbox[0];

    drain_cmd();

#ifdef P43_TASKS
    /* Cooperative step, ONCE per wake and only after the drain has finished and published
     * repl_cmd_tail. GUARDRAIL: this began inside run_line(), i.e. mid-drain, and the machine then
     * re-delivered old command bytes and echoed text from earlier lines — a task switch taken while
     * drain_cmd's cursor is live is the same re-entrancy mistake as P42's bench inside the input path.
     * GUARDRAIL: no `VM outer = vm_live` save. That copy is 136 B of C stack against a 320 B reserve,
     * and it would trade a silent stack overflow for a saved stack. vm_switch overwrites vm_live, so
     * require a clean prompt instead: sp/rsp must be zero, and refusal is loud.
     */
    if (vm_next_ready(-1) >= 0) {
        if (sp != 0u || rsp != 0u) {
            /* GUARDRAIL: report ONCE and retire the pending task. The first version only reported, so
             * the still-ready task was retried on every wake (6.46 ms) and the message repeated
             * hundreds of times — measured as a wall of "tasks need an empty stack" filling the log.
             * Retiring is loud, bounded, and recoverable: spawn again from a clean prompt. */
            int k;
            for (k = 0; k < NTSK; k++) if (tskstate[k] == 1) tskstate[k] = 2;
            msg(MSG_TASK_STACK);
        } else {
            vm_run_tasks();
        }
    }
#endif

    /* GUARDRAIL: F-157's decisive experiment - one C store to RTCIO, no interpreter, no P(). The Forth `!` reaches a real
     * 32-bit store at exactly this address (verified in the disassembly) and the HP core still sees the register unchanged,
     * so the question is whether ANY code in this ULP image can write a peripheral. If pl_hwres comes back 1 the fault is
     * in the access path the interpreter uses; if it comes back 0 the fault is in this image's environment, and the next
     * suspect is how the ULP was started. Costs 3 stores and two exported cells; the value is read by `#t` on the HP side,
     * which is also the second reader (F-156 rule). */
    /* GUARDRAIL: UNCONDITIONAL, and that is the lesson. The first version ran only when a flag written by the HP core was
     * set, and the flag never arrived - so the probe could not tell "the ULP never ran" from "the flag was never seen", and
     * it reported the wrong one ("ran=NO") for 200 ms at a time. A probe that depends on a cross-core handshake measures
     * the handshake first. Here every wake does the store and records what it read, so `#t` only has to clear the bit and
     * look: if the bit comes back and pl_hwres is 1, the C store lands; if the bit stays clear and pl_hwres went to 1, the
     * store was accepted and discarded (the echo signature). Either way the answer is a fact about the write. */
    repl_wake_count = repl_wake_count + 1u;
#if defined(HWPROBE_MIN)
    /* GUARDRAIL: the discriminator. Same 7 931-byte image, same linker, same everything - but main returns immediately
     * after the store, so no interpreter, no block layer and no drain ever runs. If the store LANDS, the fault is in what
     * our main goes on to DO; if it stays LOST, the fault is in the image itself (its size or layout), which is a very
     * different bug and points at the linker script rather than the code. */
    return 0;
#endif
#endif
    return 0;                            /* -> ulp_riscv_halt(): DONE, timer re-arms */
}
